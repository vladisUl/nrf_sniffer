## boards/others/promicro_nrf52840_my/Kconfig
```kconfig
# Copyright (c) 2024 MASSDRIVER EI (massdriver.space)
# SPDX-License-Identifier: Apache-2.0

if BOARD_PROMICRO_NRF52840_MY

config BOARD_HAS_NRF5_BOOTLOADER
	bool "Board has nRF5 bootloader"
	default n
	help
	  Enable this only for builds that must coexist with the board bootloader.
	  The normal SWD/debug build starts at address 0x0000.

endif # BOARD_PROMICRO_NRF52840_MY
```

## boards/others/promicro_nrf52840_my/board.yml
```yaml
board:
  name: promicro_nrf52840_my
  full_name: Pro Micro nRF52840
  vendor: others
  socs:
    - name: nrf52840
```

## build/802154_sniffer/Kconfig/Kconfig.shield.defconfig
```kconfig
osource "E:/ncs_workspaces/project/new/802154_sniffer/boards/shields/*/Kconfig.defconfig"
osource "E:/ncs_workspaces/zigbee-r23-340/nrf/boards/shields/*/Kconfig.defconfig"
```

## build/802154_sniffer/Kconfig/arch/Kconfig
```kconfig
# Load Zephyr Arch Kconfig descriptions.
osource "E:/ncs_workspaces/zigbee-r23-340/zephyr/arch/rx/Kconfig"
osource "E:/ncs_workspaces/zigbee-r23-340/zephyr/arch/x86/Kconfig"
osource "E:/ncs_workspaces/zigbee-r23-340/zephyr/arch/xtensa/Kconfig"
osource "E:/ncs_workspaces/zigbee-r23-340/zephyr/arch/sparc/Kconfig"
osource "E:/ncs_workspaces/zigbee-r23-340/zephyr/arch/riscv/Kconfig"
osource "E:/ncs_workspaces/zigbee-r23-340/zephyr/arch/posix/Kconfig"
osource "E:/ncs_workspaces/zigbee-r23-340/zephyr/arch/openrisc/Kconfig"
osource "E:/ncs_workspaces/zigbee-r23-340/zephyr/arch/mips/Kconfig"
osource "E:/ncs_workspaces/zigbee-r23-340/zephyr/arch/arm64/Kconfig"
osource "E:/ncs_workspaces/zigbee-r23-340/zephyr/arch/arm/Kconfig"
osource "E:/ncs_workspaces/zigbee-r23-340/zephyr/arch/arc/Kconfig"
```

## build/802154_sniffer/Kconfig/soc/Kconfig
```kconfig
# Load Zephyr SoC Kconfig descriptions.
osource "E:/ncs_workspaces/zigbee-r23-340/zephyr/soc/xlnx/zynqmp/Kconfig"
osource "E:/ncs_workspaces/zigbee-r23-340/zephyr/soc/xlnx/zynq7000/Kconfig"
osource "E:/ncs_workspaces/zigbee-r23-340/zephyr/soc/xlnx/versalnet/Kconfig"
osource "E:/ncs_workspaces/zigbee-r23-340/zephyr/soc/xlnx/versal2/Kconfig"
osource "E:/ncs_workspaces/zigbee-r23-340/zephyr/soc/xlnx/versal/Kconfig"
osource "E:/ncs_workspaces/zigbee-r23-340/zephyr/soc/xen/Kconfig"
osource "E:/ncs_workspaces/zigbee-r23-340/zephyr/soc/wch/ch32v/Kconfig"
osource "E:/ncs_workspaces/zigbee-r23-340/zephyr/soc/ti/simplelink/Kconfig"
osource "E:/ncs_workspaces/zigbee-r23-340/zephyr/soc/ti/mspm0/Kconfig"
osource "E:/ncs_workspaces/zigbee-r23-340/zephyr/soc/ti/lm3s6965/Kconfig"
osource "E:/ncs_workspaces/zigbee-r23-340/zephyr/soc/ti/k3/Kconfig"
osource "E:/ncs_workspaces/zigbee-r23-340/zephyr/soc/telink/tlsr/Kconfig"
osource "E:/ncs_workspaces/zigbee-r23-340/zephyr/soc/syna/sr100/Kconfig"
osource "E:/ncs_workspaces/zigbee-r23-340/zephyr/soc/starfive/jh71xx/Kconfig"
osource "E:/ncs_workspaces/zigbee-r23-340/zephyr/soc/st/stm32/Kconfig"
osource "E:/ncs_workspaces/zigbee-r23-340/zephyr/soc/snps/qemu_arc/Kconfig"
osource "E:/ncs_workspaces/zigbee-r23-340/zephyr/soc/snps/nsim/arc_v/Kconfig"
osource "E:/ncs_workspaces/zigbee-r23-340/zephyr/soc/snps/nsim/arc_classic/Kconfig"
osource "E:/ncs_workspaces/zigbee-r23-340/zephyr/soc/snps/hsdk4xd/Kconfig"
osource "E:/ncs_workspaces/zigbee-r23-340/zephyr/soc/snps/hsdk/Kconfig"
osource "E:/ncs_workspaces/zigbee-r23-340/zephyr/soc/snps/emsk/Kconfig"
osource "E:/ncs_workspaces/zigbee-r23-340/zephyr/soc/snps/emsdp/Kconfig"
osource "E:/ncs_workspaces/zigbee-r23-340/zephyr/soc/snps/arc_iot/Kconfig"
osource "E:/ncs_workspaces/zigbee-r23-340/zephyr/soc/silabs/Kconfig"
osource "E:/ncs_workspaces/zigbee-r23-340/zephyr/soc/sifli/sf32/Kconfig"
osource "E:/ncs_workspaces/zigbee-r23-340/zephyr/soc/sifive/sifive_freedom/Kconfig"
osource "E:/ncs_workspaces/zigbee-r23-340/zephyr/soc/sensry/Kconfig"
osource "E:/ncs_workspaces/zigbee-r23-340/zephyr/soc/rockchip/Kconfig"
osource "E:/ncs_workspaces/zigbee-r23-340/zephyr/soc/renode/riscv_virtual/Kconfig"
osource "E:/ncs_workspaces/zigbee-r23-340/zephyr/soc/renode/cortex_r8_virtual/Kconfig"
osource "E:/ncs_workspaces/zigbee-r23-340/zephyr/soc/renesas/smartbond/Kconfig"
osource "E:/ncs_workspaces/zigbee-r23-340/zephyr/soc/renesas/rz/Kconfig"
osource "E:/ncs_workspaces/zigbee-r23-340/zephyr/soc/renesas/rx/Kconfig"
osource "E:/ncs_workspaces/zigbee-r23-340/zephyr/soc/renesas/rcar/Kconfig"
osource "E:/ncs_workspaces/zigbee-r23-340/zephyr/soc/renesas/ra/Kconfig"
osource "E:/ncs_workspaces/zigbee-r23-340/zephyr/soc/realtek/fingerprint/Kconfig"
osource "E:/ncs_workspaces/zigbee-r23-340/zephyr/soc/realtek/ec/Kconfig"
osource "E:/ncs_workspaces/zigbee-r23-340/zephyr/soc/realtek/bee/Kconfig"
osource "E:/ncs_workspaces/zigbee-r23-340/zephyr/soc/realtek/ameba/Kconfig"
osource "E:/ncs_workspaces/zigbee-r23-340/zephyr/soc/raspberrypi/rpi_pico/Kconfig"
osource "E:/ncs_workspaces/zigbee-r23-340/zephyr/soc/quicklogic/eos_s3/Kconfig"
osource "E:/ncs_workspaces/zigbee-r23-340/zephyr/soc/qemu/virt_riscv/Kconfig"
osource "E:/ncs_workspaces/zigbee-r23-340/zephyr/soc/qemu/or1k/Kconfig"
osource "E:/ncs_workspaces/zigbee-r23-340/zephyr/soc/qemu/malta/Kconfig"
osource "E:/ncs_workspaces/zigbee-r23-340/zephyr/soc/openisa/rv32m1/Kconfig"
osource "E:/ncs_workspaces/zigbee-r23-340/zephyr/soc/openhwgroup/cva6/Kconfig"
osource "E:/ncs_workspaces/zigbee-r23-340/zephyr/soc/oct/osd32mp15x/Kconfig"
osource "E:/ncs_workspaces/zigbee-r23-340/zephyr/soc/nxp/s32/Kconfig"
osource "E:/ncs_workspaces/zigbee-r23-340/zephyr/soc/nxp/rw/Kconfig"
osource "E:/ncs_workspaces/zigbee-r23-340/zephyr/soc/nxp/mcx/Kconfig"
osource "E:/ncs_workspaces/zigbee-r23-340/zephyr/soc/nxp/lpc/Kconfig"
osource "E:/ncs_workspaces/zigbee-r23-340/zephyr/soc/nxp/layerscape/Kconfig"
osource "E:/ncs_workspaces/zigbee-r23-340/zephyr/soc/nxp/kinetis/Kconfig"
osource "E:/ncs_workspaces/zigbee-r23-340/zephyr/soc/nxp/imxrt/Kconfig"
osource "E:/ncs_workspaces/zigbee-r23-340/zephyr/soc/nxp/imx/Kconfig"
osource "E:/ncs_workspaces/zigbee-r23-340/zephyr/soc/nuvoton/numicro/Kconfig"
osource "E:/ncs_workspaces/zigbee-r23-340/zephyr/soc/nuvoton/numaker/Kconfig"
osource "E:/ncs_workspaces/zigbee-r23-340/zephyr/soc/nuvoton/npcx/Kconfig"
osource "E:/ncs_workspaces/zigbee-r23-340/zephyr/soc/nuvoton/npcm/Kconfig"
osource "E:/ncs_workspaces/zigbee-r23-340/zephyr/soc/nordic/Kconfig"
osource "E:/ncs_workspaces/zigbee-r23-340/zephyr/soc/neorv32/Kconfig"
osource "E:/ncs_workspaces/zigbee-r23-340/zephyr/soc/native/inf_clock/Kconfig"
osource "E:/ncs_workspaces/zigbee-r23-340/zephyr/soc/microchip/sam/sama7/Kconfig"
osource "E:/ncs_workspaces/zigbee-r23-340/zephyr/soc/microchip/sam/sam_d5x_e5x/Kconfig"
osource "E:/ncs_workspaces/zigbee-r23-340/zephyr/soc/microchip/pic64/Kconfig"
osource "E:/ncs_workspaces/zigbee-r23-340/zephyr/soc/microchip/pic32c/pic32cz_ca/Kconfig"
osource "E:/ncs_workspaces/zigbee-r23-340/zephyr/soc/microchip/pic32c/pic32cx_sg/Kconfig"
osource "E:/ncs_workspaces/zigbee-r23-340/zephyr/soc/microchip/pic32c/pic32cm_pl/Kconfig"
osource "E:/ncs_workspaces/zigbee-r23-340/zephyr/soc/microchip/pic32c/pic32cm_jh/Kconfig"
osource "E:/ncs_workspaces/zigbee-r23-340/zephyr/soc/microchip/miv/Kconfig"
osource "E:/ncs_workspaces/zigbee-r23-340/zephyr/soc/microchip/mec/Kconfig"
osource "E:/ncs_workspaces/zigbee-r23-340/zephyr/soc/mediatek/mt8xxx/Kconfig"
osource "E:/ncs_workspaces/zigbee-r23-340/zephyr/soc/lowrisc/opentitan/Kconfig"
osource "E:/ncs_workspaces/zigbee-r23-340/zephyr/soc/litex/litex_vexriscv/Kconfig"
osource "E:/ncs_workspaces/zigbee-r23-340/zephyr/soc/ite/ec/Kconfig"
osource "E:/ncs_workspaces/zigbee-r23-340/zephyr/soc/intel/wildcat_lake/Kconfig"
osource "E:/ncs_workspaces/zigbee-r23-340/zephyr/soc/intel/raptor_lake/Kconfig"
osource "E:/ncs_workspaces/zigbee-r23-340/zephyr/soc/intel/panther_lake/Kconfig"
osource "E:/ncs_workspaces/zigbee-r23-340/zephyr/soc/intel/lakemont/Kconfig"
osource "E:/ncs_workspaces/zigbee-r23-340/zephyr/soc/intel/intel_socfpga_std/Kconfig"
osource "E:/ncs_workspaces/zigbee-r23-340/zephyr/soc/intel/intel_socfpga/Kconfig"
osource "E:/ncs_workspaces/zigbee-r23-340/zephyr/soc/intel/intel_niosv/Kconfig"
osource "E:/ncs_workspaces/zigbee-r23-340/zephyr/soc/intel/intel_ish/Kconfig"
osource "E:/ncs_workspaces/zigbee-r23-340/zephyr/soc/intel/intel_adsp/Kconfig"
osource "E:/ncs_workspaces/zigbee-r23-340/zephyr/soc/intel/elkhart_lake/Kconfig"
osource "E:/ncs_workspaces/zigbee-r23-340/zephyr/soc/intel/atom/Kconfig"
osource "E:/ncs_workspaces/zigbee-r23-340/zephyr/soc/intel/apollo_lake/Kconfig"
osource "E:/ncs_workspaces/zigbee-r23-340/zephyr/soc/intel/alder_lake/Kconfig"
osource "E:/ncs_workspaces/zigbee-r23-340/zephyr/soc/infineon/psoc4/Kconfig"
osource "E:/ncs_workspaces/zigbee-r23-340/zephyr/soc/infineon/edge/Kconfig"
osource "E:/ncs_workspaces/zigbee-r23-340/zephyr/soc/infineon/cat3/Kconfig"
osource "E:/ncs_workspaces/zigbee-r23-340/zephyr/soc/infineon/cat1c/Kconfig"
osource "E:/ncs_workspaces/zigbee-r23-340/zephyr/soc/infineon/cat1b/Kconfig"
osource "E:/ncs_workspaces/zigbee-r23-340/zephyr/soc/infineon/cat1a/Kconfig"
osource "E:/ncs_workspaces/zigbee-r23-340/zephyr/soc/gd/gd32/Kconfig"
osource "E:/ncs_workspaces/zigbee-r23-340/zephyr/soc/gaisler/leon3/Kconfig"
osource "E:/ncs_workspaces/zigbee-r23-340/zephyr/soc/gaisler/gr716a/Kconfig"
osource "E:/ncs_workspaces/zigbee-r23-340/zephyr/soc/focaltech/Kconfig"
osource "E:/ncs_workspaces/zigbee-r23-340/zephyr/soc/espressif/Kconfig"
osource "E:/ncs_workspaces/zigbee-r23-340/zephyr/soc/ene/kb1200/Kconfig"
osource "E:/ncs_workspaces/zigbee-r23-340/zephyr/soc/ene/kb106x/Kconfig"
osource "E:/ncs_workspaces/zigbee-r23-340/zephyr/soc/elan/em32f967/Kconfig"
osource "E:/ncs_workspaces/zigbee-r23-340/zephyr/soc/egis/Kconfig"
osource "E:/ncs_workspaces/zigbee-r23-340/zephyr/soc/efinix/sapphire/Kconfig"
osource "E:/ncs_workspaces/zigbee-r23-340/zephyr/soc/cdns/xtensa_sample_controller/Kconfig"
osource "E:/ncs_workspaces/zigbee-r23-340/zephyr/soc/cdns/swerv/Kconfig"
osource "E:/ncs_workspaces/zigbee-r23-340/zephyr/soc/cdns/sample_controller32/Kconfig"
osource "E:/ncs_workspaces/zigbee-r23-340/zephyr/soc/cdns/dc233c/Kconfig"
osource "E:/ncs_workspaces/zigbee-r23-340/zephyr/soc/brcm/bcmvk/Kconfig"
osource "E:/ncs_workspaces/zigbee-r23-340/zephyr/soc/brcm/bcm2712/Kconfig"
osource "E:/ncs_workspaces/zigbee-r23-340/zephyr/soc/brcm/bcm2711/Kconfig"
osource "E:/ncs_workspaces/zigbee-r23-340/zephyr/soc/blackberry/qnxhv_vm/Kconfig"
osource "E:/ncs_workspaces/zigbee-r23-340/zephyr/soc/bflb/Kconfig"
osource "E:/ncs_workspaces/zigbee-r23-340/zephyr/soc/atmel/sam0/Kconfig"
osource "E:/ncs_workspaces/zigbee-r23-340/zephyr/soc/atmel/sam/Kconfig"
osource "E:/ncs_workspaces/zigbee-r23-340/zephyr/soc/aspeed/Kconfig"
osource "E:/ncs_workspaces/zigbee-r23-340/zephyr/soc/arm/Kconfig"
osource "E:/ncs_workspaces/zigbee-r23-340/zephyr/soc/arm/beetle/Kconfig"
osource "E:/ncs_workspaces/zigbee-r23-340/zephyr/soc/antmicro/myra/Kconfig"
osource "E:/ncs_workspaces/zigbee-r23-340/zephyr/soc/andestech/Kconfig"
osource "E:/ncs_workspaces/zigbee-r23-340/zephyr/soc/amd/acp_6_0/Kconfig"
osource "E:/ncs_workspaces/zigbee-r23-340/zephyr/soc/ambiq/Kconfig"
osource "E:/ncs_workspaces/zigbee-r23-340/zephyr/soc/allwinner/sun8i_h3/Kconfig"
osource "E:/ncs_workspaces/zigbee-r23-340/zephyr/soc/alif/ensemble/Kconfig"
osource "E:/ncs_workspaces/zigbee-r23-340/zephyr/soc/aesc/Kconfig"
osource "E:/ncs_workspaces/zigbee-r23-340/zephyr/soc/adi/max32/Kconfig"
osource "E:/ncs_workspaces/zigbee-r23-340/nrf/soc/sercomm/nrf91/Kconfig"
osource "E:/ncs_workspaces/zigbee-r23-340/nrf/soc/nordic/Kconfig"
```

## build/Kconfig/Kconfig.shield
```kconfig
osource "E:/ncs_workspaces/project/new/802154_sniffer/boards/shields/*/Kconfig.shield"
osource "E:/ncs_workspaces/zigbee-r23-340/nrf/boards/shields/*/Kconfig.shield"
```

## build/Kconfig/boards/Kconfig
```kconfig
# Load Zephyr board Kconfig descriptions.
osource "E:/ncs_workspaces/project/new/802154_sniffer/boards/others/promicro_nrf52840_my/Kconfig"
```

## build/Kconfig/boards/Kconfig.defconfig.tmp
```kconfig
# Load Zephyr board defconfig descriptions.
osource "E:/ncs_workspaces/project/new/802154_sniffer/boards/others/promicro_nrf52840_my/Kconfig.defconfig"
```

## build/Kconfig/boards/Kconfig.promicro_nrf52840_my.tmp
```kconfig
# Load board Kconfig descriptions.
osource "E:/ncs_workspaces/project/new/802154_sniffer/boards/others/promicro_nrf52840_my/Kconfig.promicro_nrf52840_my"
```
