## build/Kconfig/soc/Kconfig.sysbuild
```kconfig
# Load Sysbuild SoC Kconfig descriptions.
osource "E:/ncs_workspaces/zigbee-r23-340/zephyr/soc/xlnx/zynqmp/Kconfig.sysbuild"
osource "E:/ncs_workspaces/zigbee-r23-340/zephyr/soc/xlnx/zynq7000/Kconfig.sysbuild"
osource "E:/ncs_workspaces/zigbee-r23-340/zephyr/soc/xlnx/versalnet/Kconfig.sysbuild"
osource "E:/ncs_workspaces/zigbee-r23-340/zephyr/soc/xlnx/versal2/Kconfig.sysbuild"
osource "E:/ncs_workspaces/zigbee-r23-340/zephyr/soc/xlnx/versal/Kconfig.sysbuild"
osource "E:/ncs_workspaces/zigbee-r23-340/zephyr/soc/xen/Kconfig.sysbuild"
osource "E:/ncs_workspaces/zigbee-r23-340/zephyr/soc/wch/ch32v/Kconfig.sysbuild"
osource "E:/ncs_workspaces/zigbee-r23-340/zephyr/soc/ti/simplelink/Kconfig.sysbuild"
osource "E:/ncs_workspaces/zigbee-r23-340/zephyr/soc/ti/mspm0/Kconfig.sysbuild"
osource "E:/ncs_workspaces/zigbee-r23-340/zephyr/soc/ti/lm3s6965/Kconfig.sysbuild"
osource "E:/ncs_workspaces/zigbee-r23-340/zephyr/soc/ti/k3/Kconfig.sysbuild"
osource "E:/ncs_workspaces/zigbee-r23-340/zephyr/soc/telink/tlsr/Kconfig.sysbuild"
osource "E:/ncs_workspaces/zigbee-r23-340/zephyr/soc/syna/sr100/Kconfig.sysbuild"
osource "E:/ncs_workspaces/zigbee-r23-340/zephyr/soc/starfive/jh71xx/Kconfig.sysbuild"
osource "E:/ncs_workspaces/zigbee-r23-340/zephyr/soc/st/stm32/Kconfig.sysbuild"
osource "E:/ncs_workspaces/zigbee-r23-340/zephyr/soc/snps/qemu_arc/Kconfig.sysbuild"
osource "E:/ncs_workspaces/zigbee-r23-340/zephyr/soc/snps/nsim/arc_v/Kconfig.sysbuild"
osource "E:/ncs_workspaces/zigbee-r23-340/zephyr/soc/snps/nsim/arc_classic/Kconfig.sysbuild"
osource "E:/ncs_workspaces/zigbee-r23-340/zephyr/soc/snps/hsdk4xd/Kconfig.sysbuild"
osource "E:/ncs_workspaces/zigbee-r23-340/zephyr/soc/snps/hsdk/Kconfig.sysbuild"
osource "E:/ncs_workspaces/zigbee-r23-340/zephyr/soc/snps/emsk/Kconfig.sysbuild"
osource "E:/ncs_workspaces/zigbee-r23-340/zephyr/soc/snps/emsdp/Kconfig.sysbuild"
osource "E:/ncs_workspaces/zigbee-r23-340/zephyr/soc/snps/arc_iot/Kconfig.sysbuild"
osource "E:/ncs_workspaces/zigbee-r23-340/zephyr/soc/silabs/Kconfig.sysbuild"
osource "E:/ncs_workspaces/zigbee-r23-340/zephyr/soc/sifli/sf32/Kconfig.sysbuild"
osource "E:/ncs_workspaces/zigbee-r23-340/zephyr/soc/sifive/sifive_freedom/Kconfig.sysbuild"
osource "E:/ncs_workspaces/zigbee-r23-340/zephyr/soc/sensry/Kconfig.sysbuild"
osource "E:/ncs_workspaces/zigbee-r23-340/zephyr/soc/rockchip/Kconfig.sysbuild"
osource "E:/ncs_workspaces/zigbee-r23-340/zephyr/soc/renode/riscv_virtual/Kconfig.sysbuild"
osource "E:/ncs_workspaces/zigbee-r23-340/zephyr/soc/renode/cortex_r8_virtual/Kconfig.sysbuild"
osource "E:/ncs_workspaces/zigbee-r23-340/zephyr/soc/renesas/smartbond/Kconfig.sysbuild"
osource "E:/ncs_workspaces/zigbee-r23-340/zephyr/soc/renesas/rz/Kconfig.sysbuild"
osource "E:/ncs_workspaces/zigbee-r23-340/zephyr/soc/renesas/rx/Kconfig.sysbuild"
osource "E:/ncs_workspaces/zigbee-r23-340/zephyr/soc/renesas/rcar/Kconfig.sysbuild"
osource "E:/ncs_workspaces/zigbee-r23-340/zephyr/soc/renesas/ra/Kconfig.sysbuild"
osource "E:/ncs_workspaces/zigbee-r23-340/zephyr/soc/realtek/fingerprint/Kconfig.sysbuild"
osource "E:/ncs_workspaces/zigbee-r23-340/zephyr/soc/realtek/ec/Kconfig.sysbuild"
osource "E:/ncs_workspaces/zigbee-r23-340/zephyr/soc/realtek/bee/Kconfig.sysbuild"
osource "E:/ncs_workspaces/zigbee-r23-340/zephyr/soc/realtek/ameba/Kconfig.sysbuild"
osource "E:/ncs_workspaces/zigbee-r23-340/zephyr/soc/raspberrypi/rpi_pico/Kconfig.sysbuild"
osource "E:/ncs_workspaces/zigbee-r23-340/zephyr/soc/quicklogic/eos_s3/Kconfig.sysbuild"
osource "E:/ncs_workspaces/zigbee-r23-340/zephyr/soc/qemu/virt_riscv/Kconfig.sysbuild"
osource "E:/ncs_workspaces/zigbee-r23-340/zephyr/soc/qemu/or1k/Kconfig.sysbuild"
osource "E:/ncs_workspaces/zigbee-r23-340/zephyr/soc/qemu/malta/Kconfig.sysbuild"
osource "E:/ncs_workspaces/zigbee-r23-340/zephyr/soc/openisa/rv32m1/Kconfig.sysbuild"
osource "E:/ncs_workspaces/zigbee-r23-340/zephyr/soc/openhwgroup/cva6/Kconfig.sysbuild"
osource "E:/ncs_workspaces/zigbee-r23-340/zephyr/soc/oct/osd32mp15x/Kconfig.sysbuild"
osource "E:/ncs_workspaces/zigbee-r23-340/zephyr/soc/nxp/s32/Kconfig.sysbuild"
osource "E:/ncs_workspaces/zigbee-r23-340/zephyr/soc/nxp/rw/Kconfig.sysbuild"
osource "E:/ncs_workspaces/zigbee-r23-340/zephyr/soc/nxp/mcx/Kconfig.sysbuild"
osource "E:/ncs_workspaces/zigbee-r23-340/zephyr/soc/nxp/lpc/Kconfig.sysbuild"
osource "E:/ncs_workspaces/zigbee-r23-340/zephyr/soc/nxp/layerscape/Kconfig.sysbuild"
osource "E:/ncs_workspaces/zigbee-r23-340/zephyr/soc/nxp/kinetis/Kconfig.sysbuild"
osource "E:/ncs_workspaces/zigbee-r23-340/zephyr/soc/nxp/imxrt/Kconfig.sysbuild"
osource "E:/ncs_workspaces/zigbee-r23-340/zephyr/soc/nxp/imx/Kconfig.sysbuild"
osource "E:/ncs_workspaces/zigbee-r23-340/zephyr/soc/nuvoton/numicro/Kconfig.sysbuild"
osource "E:/ncs_workspaces/zigbee-r23-340/zephyr/soc/nuvoton/numaker/Kconfig.sysbuild"
osource "E:/ncs_workspaces/zigbee-r23-340/zephyr/soc/nuvoton/npcx/Kconfig.sysbuild"
osource "E:/ncs_workspaces/zigbee-r23-340/zephyr/soc/nuvoton/npcm/Kconfig.sysbuild"
osource "E:/ncs_workspaces/zigbee-r23-340/zephyr/soc/nordic/Kconfig.sysbuild"
osource "E:/ncs_workspaces/zigbee-r23-340/zephyr/soc/neorv32/Kconfig.sysbuild"
osource "E:/ncs_workspaces/zigbee-r23-340/zephyr/soc/native/inf_clock/Kconfig.sysbuild"
osource "E:/ncs_workspaces/zigbee-r23-340/zephyr/soc/microchip/sam/sama7/Kconfig.sysbuild"
osource "E:/ncs_workspaces/zigbee-r23-340/zephyr/soc/microchip/sam/sam_d5x_e5x/Kconfig.sysbuild"
osource "E:/ncs_workspaces/zigbee-r23-340/zephyr/soc/microchip/pic64/Kconfig.sysbuild"
osource "E:/ncs_workspaces/zigbee-r23-340/zephyr/soc/microchip/pic32c/pic32cz_ca/Kconfig.sysbuild"
osource "E:/ncs_workspaces/zigbee-r23-340/zephyr/soc/microchip/pic32c/pic32cx_sg/Kconfig.sysbuild"
osource "E:/ncs_workspaces/zigbee-r23-340/zephyr/soc/microchip/pic32c/pic32cm_pl/Kconfig.sysbuild"
osource "E:/ncs_workspaces/zigbee-r23-340/zephyr/soc/microchip/pic32c/pic32cm_jh/Kconfig.sysbuild"
osource "E:/ncs_workspaces/zigbee-r23-340/zephyr/soc/microchip/miv/Kconfig.sysbuild"
osource "E:/ncs_workspaces/zigbee-r23-340/zephyr/soc/microchip/mec/Kconfig.sysbuild"
osource "E:/ncs_workspaces/zigbee-r23-340/zephyr/soc/mediatek/mt8xxx/Kconfig.sysbuild"
osource "E:/ncs_workspaces/zigbee-r23-340/zephyr/soc/lowrisc/opentitan/Kconfig.sysbuild"
osource "E:/ncs_workspaces/zigbee-r23-340/zephyr/soc/litex/litex_vexriscv/Kconfig.sysbuild"
osource "E:/ncs_workspaces/zigbee-r23-340/zephyr/soc/ite/ec/Kconfig.sysbuild"
osource "E:/ncs_workspaces/zigbee-r23-340/zephyr/soc/intel/wildcat_lake/Kconfig.sysbuild"
osource "E:/ncs_workspaces/zigbee-r23-340/zephyr/soc/intel/raptor_lake/Kconfig.sysbuild"
osource "E:/ncs_workspaces/zigbee-r23-340/zephyr/soc/intel/panther_lake/Kconfig.sysbuild"
osource "E:/ncs_workspaces/zigbee-r23-340/zephyr/soc/intel/lakemont/Kconfig.sysbuild"
osource "E:/ncs_workspaces/zigbee-r23-340/zephyr/soc/intel/intel_socfpga_std/Kconfig.sysbuild"
osource "E:/ncs_workspaces/zigbee-r23-340/zephyr/soc/intel/intel_socfpga/Kconfig.sysbuild"
osource "E:/ncs_workspaces/zigbee-r23-340/zephyr/soc/intel/intel_niosv/Kconfig.sysbuild"
osource "E:/ncs_workspaces/zigbee-r23-340/zephyr/soc/intel/intel_ish/Kconfig.sysbuild"
osource "E:/ncs_workspaces/zigbee-r23-340/zephyr/soc/intel/intel_adsp/Kconfig.sysbuild"
osource "E:/ncs_workspaces/zigbee-r23-340/zephyr/soc/intel/elkhart_lake/Kconfig.sysbuild"
osource "E:/ncs_workspaces/zigbee-r23-340/zephyr/soc/intel/atom/Kconfig.sysbuild"
osource "E:/ncs_workspaces/zigbee-r23-340/zephyr/soc/intel/apollo_lake/Kconfig.sysbuild"
osource "E:/ncs_workspaces/zigbee-r23-340/zephyr/soc/intel/alder_lake/Kconfig.sysbuild"
osource "E:/ncs_workspaces/zigbee-r23-340/zephyr/soc/infineon/psoc4/Kconfig.sysbuild"
osource "E:/ncs_workspaces/zigbee-r23-340/zephyr/soc/infineon/edge/Kconfig.sysbuild"
osource "E:/ncs_workspaces/zigbee-r23-340/zephyr/soc/infineon/cat3/Kconfig.sysbuild"
osource "E:/ncs_workspaces/zigbee-r23-340/zephyr/soc/infineon/cat1c/Kconfig.sysbuild"
osource "E:/ncs_workspaces/zigbee-r23-340/zephyr/soc/infineon/cat1b/Kconfig.sysbuild"
osource "E:/ncs_workspaces/zigbee-r23-340/zephyr/soc/infineon/cat1a/Kconfig.sysbuild"
osource "E:/ncs_workspaces/zigbee-r23-340/zephyr/soc/gd/gd32/Kconfig.sysbuild"
osource "E:/ncs_workspaces/zigbee-r23-340/zephyr/soc/gaisler/leon3/Kconfig.sysbuild"
osource "E:/ncs_workspaces/zigbee-r23-340/zephyr/soc/gaisler/gr716a/Kconfig.sysbuild"
osource "E:/ncs_workspaces/zigbee-r23-340/zephyr/soc/focaltech/Kconfig.sysbuild"
osource "E:/ncs_workspaces/zigbee-r23-340/zephyr/soc/espressif/Kconfig.sysbuild"
osource "E:/ncs_workspaces/zigbee-r23-340/zephyr/soc/ene/kb1200/Kconfig.sysbuild"
osource "E:/ncs_workspaces/zigbee-r23-340/zephyr/soc/ene/kb106x/Kconfig.sysbuild"
osource "E:/ncs_workspaces/zigbee-r23-340/zephyr/soc/elan/em32f967/Kconfig.sysbuild"
osource "E:/ncs_workspaces/zigbee-r23-340/zephyr/soc/egis/Kconfig.sysbuild"
osource "E:/ncs_workspaces/zigbee-r23-340/zephyr/soc/efinix/sapphire/Kconfig.sysbuild"
osource "E:/ncs_workspaces/zigbee-r23-340/zephyr/soc/cdns/xtensa_sample_controller/Kconfig.sysbuild"
osource "E:/ncs_workspaces/zigbee-r23-340/zephyr/soc/cdns/swerv/Kconfig.sysbuild"
osource "E:/ncs_workspaces/zigbee-r23-340/zephyr/soc/cdns/sample_controller32/Kconfig.sysbuild"
osource "E:/ncs_workspaces/zigbee-r23-340/zephyr/soc/cdns/dc233c/Kconfig.sysbuild"
osource "E:/ncs_workspaces/zigbee-r23-340/zephyr/soc/brcm/bcmvk/Kconfig.sysbuild"
osource "E:/ncs_workspaces/zigbee-r23-340/zephyr/soc/brcm/bcm2712/Kconfig.sysbuild"
osource "E:/ncs_workspaces/zigbee-r23-340/zephyr/soc/brcm/bcm2711/Kconfig.sysbuild"
osource "E:/ncs_workspaces/zigbee-r23-340/zephyr/soc/blackberry/qnxhv_vm/Kconfig.sysbuild"
osource "E:/ncs_workspaces/zigbee-r23-340/zephyr/soc/bflb/Kconfig.sysbuild"
osource "E:/ncs_workspaces/zigbee-r23-340/zephyr/soc/atmel/sam0/Kconfig.sysbuild"
osource "E:/ncs_workspaces/zigbee-r23-340/zephyr/soc/atmel/sam/Kconfig.sysbuild"
osource "E:/ncs_workspaces/zigbee-r23-340/zephyr/soc/aspeed/Kconfig.sysbuild"
osource "E:/ncs_workspaces/zigbee-r23-340/zephyr/soc/arm/Kconfig.sysbuild"
osource "E:/ncs_workspaces/zigbee-r23-340/zephyr/soc/arm/beetle/Kconfig.sysbuild"
osource "E:/ncs_workspaces/zigbee-r23-340/zephyr/soc/antmicro/myra/Kconfig.sysbuild"
osource "E:/ncs_workspaces/zigbee-r23-340/zephyr/soc/andestech/Kconfig.sysbuild"
osource "E:/ncs_workspaces/zigbee-r23-340/zephyr/soc/amd/acp_6_0/Kconfig.sysbuild"
osource "E:/ncs_workspaces/zigbee-r23-340/zephyr/soc/ambiq/Kconfig.sysbuild"
osource "E:/ncs_workspaces/zigbee-r23-340/zephyr/soc/allwinner/sun8i_h3/Kconfig.sysbuild"
osource "E:/ncs_workspaces/zigbee-r23-340/zephyr/soc/alif/ensemble/Kconfig.sysbuild"
osource "E:/ncs_workspaces/zigbee-r23-340/zephyr/soc/aesc/Kconfig.sysbuild"
osource "E:/ncs_workspaces/zigbee-r23-340/zephyr/soc/adi/max32/Kconfig.sysbuild"
osource "E:/ncs_workspaces/zigbee-r23-340/nrf/soc/sercomm/nrf91/Kconfig.sysbuild"
osource "E:/ncs_workspaces/zigbee-r23-340/nrf/soc/nordic/Kconfig.sysbuild"
```

## sample.yaml
```yaml
sample:
  description: Low-cost IEEE 802.15.4 sniffer for ProMicro nRF52840
  name: ProMicro nRF52840 IEEE 802.15.4 Sniffer
tests:
  sample.peripheral.802154_sniffer.promicro:
    sysbuild: true
    build_only: true
    integration_platforms:
      - promicro_nrf52840_my/nrf52840
    platform_allow:
      - promicro_nrf52840_my/nrf52840
    tags:
      - ieee802154
      - sniffer
      - sysbuild
```
